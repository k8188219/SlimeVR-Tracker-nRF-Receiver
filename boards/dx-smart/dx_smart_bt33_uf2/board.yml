## boards/dx-smart/dx_smart_bt33_uf2/board.yml
```yaml
# Copyright (c) 2024 Nordic Semiconductor ASA
# SPDX-License-Identifier: Apache-2.0

board:
  name: dx-smart-bt33-uf2
  vendor: dx-smart
  socs:
    - name: nrf52833
```
